#include <homephone.h>
//homephone lcd(A4, A2, A3, A1, A5);
// homephone lcd(A2, A4, A3, A5, A1);//2 4 3 5 1 
homephone lcd(A5, A3, A4, A2, A1);//SDIN SLK A RESET CS
//lcd( RST, SCLK, A0, SID,CS)
     //   SDIN SLK A RESET CS
String inputString = "";         // a string to hold incoming data
boolean stringComplete = false;  // whether the string is complete
String cpuTemp, cpuLoad,cpuClock, ramLoad,ramUsed, gpuTemp, gpuRam,gpuRamLoad, gpuRamUsed, gpuLoad, gpuClock, gpuRamClock;
int fromInd,toInd;
bool capture = false;
int gpuRow=29;
int loadCol=24;
int tempCol=54;
int clockCol=93;
int cpuRow=15;
int ramRow=46;
const byte interruptPin = 3;
volatile int mode = 0;
const uint8_t _gpu[] PROGMEM = {
0xC0, 0x00, 0x00, 0x7F, 0xFF, 0xFE, 0x78, 0xFF, 0x8E, 0x70, 0x7F, 0x06, 0x65, 0x3E, 0x52, 0x62,
0x3E, 0x22, 0x65, 0x3E, 0x52, 0x70, 0x7F, 0x06, 0x78, 0xFF, 0x8E, 0x7F, 0xFF, 0xFE, 0x5F, 0xD0,
0x00, 0x40, 0x00, 0x00, 
};

const uint8_t _ram[] PROGMEM = {
0xFF, 0xFF, 0xFC, 0xFF, 0xFF, 0xFC, 0xCC, 0xCC, 0xCC, 0xCC, 0xCC, 0xCC, 0xCC, 0xCC, 0xCC, 0xFF,
0xFF, 0xFC, 0xFF, 0xFF, 0xFC, 0x7F, 0x7F, 0xF8, 
};

const uint8_t _cpu[] PROGMEM = {
0x09, 0x20, 0x7F, 0xFC, 0x4F, 0xFC, 0x5F, 0xFC, 0xFF, 0xFE, 0x44, 0x54, 0x5D, 0x54, 0xDC, 0x56,
0x5D, 0xD4, 0x45, 0xC4, 0xFF, 0xFE, 0x7F, 0xF4, 0x7F, 0xE4, 0x7F, 0xFC, 0x09, 0x20, 0x00, 0x00
};

const unsigned char _vga [] = {
0x20,0x20,0xE0,0xC0,0xC0,0xC0,0xC0,0xC0,0xC0,0xC0,0xC0,0xC0,0xC0,0xC0,0xC0,0xC0,
0xC0,0xC0,0xC0,0xC0,0xC0,0xC0,0xC0,0x80
};

 const uint8_t _square[] PROGMEM ={
0x00, 0x00, 0x00, 0x00, 0x92, 0x00, 0x00, 0x92, 0x00, 0x00, 0x00, 0x00, 0x0F, 0xFF, 0xE0, 0x08,
0xFF, 0xE0, 0x0B, 0xFF, 0xE0, 0x0B, 0xFF, 0xE0, 0x6F, 0xFF, 0xEC, 0x0C, 0x45, 0x60, 0x0D, 0xD5,
0x60, 0x6D, 0xC5, 0x6C, 0x0D, 0xDD, 0x60, 0x0C, 0x5C, 0x60, 0x6F, 0xFF, 0xEC, 0x0F, 0xFF, 0xA0,
0x0F, 0xFF, 0xA0, 0x0F, 0xFE, 0x20, 0x0F, 0xFF, 0xE0, 0x00, 0x00, 0x00, 0x00, 0x92, 0x00, 0x00,
0x92, 0x00, 0x00, 0x00, 0x00, 0x00, 0x00, 0x00  };

const uint8_t _temp[] PROGMEM ={
0x10, 0x28, 0x28, 0x28, 0x38, 0x7C, 0x38, 0x10,}; 

const uint8_t _celsius[] PROGMEM ={
0xE6, 0xA9, 0xE8, 0x08, 0x08, 0x09, 0x06, 0x00, }; 

const uint8_t _temp16[] PROGMEM = {
0x20, 0x70, 0x50, 0x50, 0x50, 0x70, 0x70, 0x70, 0xF8, 0xF8, 0xF8, 0x70, 0x00, 0x00, 0x00, 0x00,
0x00, 0x00, 0x00, 0x00, 0x00, 0x00, };

const uint8_t _pwm[] PROGMEM = {
0x0F, 0x80, 0x30, 0x60, 0x40, 0x10, 0x4E, 0xD0, 0x8A, 0x88, 0x8A, 0x88, 0x8A, 0x88, 0x8A, 0x88,
0x8A, 0x88, 0x5B, 0x90, 0x40, 0x10, 0x30, 0x60, 0x0F, 0x80, 0x00, 0x00, 0x00, 0x00, 0x00, 0x00};

const uint8_t _pwms[] PROGMEM = {
0x1F, 0x00, 0x60, 0xC0, 0x40, 0x40, 0x9D, 0xA0, 0x95, 0x20, 0x95, 0x20, 0x95, 0x20, 0xB7, 0x20,
0x40, 0x40, 0x60, 0xC0, 0x1F, 0x00, 0x00, 0x00, 0x00, 0x00, 0x00, 0x00, 0x00, 0x00, 0x00, 0x00};
const uint8_t _vgaram[] PROGMEM = {
0x7C, 0x44, 0xC6, 0x44, 0xC6, 0x44, 0xC6, 0x54, 0x7C, 0x00, 0x00, 0x00, 0x00, 0x00, 0x00, 0x00};


const uint8_t _icon[] PROGMEM = {
0x00, 0x20, 0x00, 0x20, 0x20, 0x20, 0x20, 0x28, 0x20, 0xA8, 0x22, 0xA8, 0x2A, 0x88, 0x2A, 0x08,
0x28, 0x08, 0x08, 0x08, 0x08, 0x00, 0x08, 0x00, 0x00, 0x00, 0x00, 0x00, 0x00, 0x00, 0x00, 0x00
};

const uint8_t _icon32[] PROGMEM = {
0x00, 0x00, 0x00, 0x00, 0x00, 0x00, 0x00, 0x00, 0x00, 0x00, 0x00, 0x00, 0x00, 0x00, 0x0C, 0x00,
0x00, 0x00, 0x0C, 0x00, 0x00, 0x00, 0x0C, 0x00, 0x00, 0x00, 0x0C, 0x00, 0x0C, 0x00, 0x0C, 0x00,
0x0C, 0x00, 0x0C, 0x00, 0x0C, 0x00, 0x0C, 0x00, 0x0C, 0x00, 0x0C, 0x00, 0x0C, 0x00, 0xCC, 0xC0,
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0x00, 0xC0, 0x00, 0x00, 0x00, 0x00, 0x00, 0x00, 0x00, 0x00, 0x00, 0x00, 0x00, 0x00, 0x00, 0x00};


void setup() {

  pinMode(interruptPin, INPUT_PULLUP);
  attachInterrupt(digitalPinToInterrupt(interruptPin), interupt, FALLING);
  
  Serial.begin(9600);
  inputString.reserve(200);
  lcd.begin();
  lcd.setContrast(0x08);
  lcd.clearDisplay();
  lcd.setTextColor(black, white);
  lcd.display();
  delay(2000);
  lcd.clearDisplay();
  interfaceInit();
}

void interupt() {
  mode+=1;
  
}
void interfaceInit(){ 
  

    lcd.setCursor(0, 3);
    lcd.print(" Frozen <   > Throne ");
    lcd.drawBitmap(56,0,_icon,16,16,black,white);
    
    lcd.drawBitmap(4,cpuRow,_cpu,16,16,black,white);

  lcd.drawBitmap(0,gpuRow+2,_gpu,24,12,black,white);
  lcd.drawBitmap(0,ramRow,_ram,24,8,black,white); 
  
    
  lcd.drawBitmap(tempCol,cpuRow+1,_temp16,8,16,black,white); 
  lcd.drawBitmap(tempCol,gpuRow+1,_temp16,8,16,black,white); 

  lcd.drawBitmap(tempCol-1,ramRow-1,_vgaram,8,16,black,white); 

  lcd.drawBitmap(clockCol,cpuRow+2,_pwms,16,16,black,white); 
  lcd.drawBitmap(clockCol,gpuRow+2,_pwms,16,16,black,white);
  lcd.drawBitmap(clockCol,ramRow-2,_pwms,16,16,black,white); 
  
  lcd.drawBitmap(tempCol+23,gpuRow+4,_celsius,8,8,black,white); 
   lcd.drawBitmap(tempCol+23,cpuRow+4,_celsius,8,8,black,white); 
  lcd.display();
}

void loop() {
 
  if (stringComplete) {

    lcd.setCursor(10, 0);
    lcd.print((String)"cpu temp "+cpuTemp);
    lcd.setCursor(loadCol, cpuRow+4);
    lcd.print(cpuLoad+"%");

    lcd.setCursor(128-23 ,cpuRow+4 );
    lcd.print(cpuClock);

    lcd.setCursor(tempCol+9, cpuRow+4);
    lcd.print(cpuTemp);

    lcd.setCursor(loadCol,gpuRow+4);
    lcd.print(gpuLoad+"%");
     
    lcd.setCursor(tempCol+9, gpuRow+4);
    lcd.print(gpuTemp);

    lcd.setCursor(128-23,gpuRow+4 );
    lcd.print(gpuClock);

    lcd.setCursor(128-23,ramRow );
    lcd.print(gpuRamClock);

    lcd.setCursor(tempCol+7, ramRow);
    lcd.print(gpuRamLoad+"%");
   //+gpuRamUsed+"/"+gpuRam+"GB");

    lcd.setCursor(loadCol, ramRow);
    lcd.print(ramLoad+"%");

    lcd.setCursor(3, 57);
    lcd.print(ramUsed+"GB");

    
    lcd.setCursor(tempCol, 57);
    lcd.print(gpuRamUsed+"/"+gpuRam+"G");

    lcd.display();
    inputString = "";
    stringComplete = false;
  }
}
String extract(String input){
      String res;
      toInd = input.indexOf(',',fromInd);  //finds location of first ,
      res = input.substring(fromInd, toInd);   //captures first data String
      fromInd=toInd+1;
      return res;
}
void serialEvent() {
  while (Serial.available()) {
    // get the new byte:
    char inChar = (char)Serial.read();
    if (inChar == '/') {
      capture=true;
      inputString="";
    }
    if (inChar == '*') {
      fromInd=1;
      cpuTemp=extract(inputString);
      cpuLoad=extract(inputString);
      
      cpuClock=extract(inputString);
      ramLoad=extract(inputString);
      ramUsed=extract(inputString);
      gpuClock=extract(inputString);
      gpuRamClock=extract(inputString);
      gpuLoad=extract(inputString);
      gpuRamUsed=extract(inputString);
      gpuRam=extract(inputString);
      gpuRamLoad=extract(inputString);      
      gpuTemp=extract(inputString);

      stringComplete = true;
      capture=false;
    }  
    else if(capture){     
      inputString += inChar; //makes the string inputString
    }
  }
}
